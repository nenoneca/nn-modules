## modules/libs/nn_camera/Kconfig
```kconfig
# SPDX-License-Identifier: Apache-2.0
menu "nn_camera (MIPI-CSI + hardware H.264)"
	depends on NN_FEATURE_CAMERA

config NN_CAMERA_SCCB_SCL_IO
	int "Camera SCCB (I2C) SCL GPIO"
	default 8

config NN_CAMERA_SCCB_SDA_IO
	int "Camera SCCB (I2C) SDA GPIO"
	default 7

# The active sensor + its MIPI mode/lane-rate/RAW format are selected by the
# esp_cam_sensor driver (CONFIG_CAMERA_<SENSOR>_MIPI_*), which owns bring-up.
# nn_camera only needs the negotiated capture geometry below.

config NN_CAMERA_HRES
	int "Encoder output width (pixels, multiple of 16)"
	default 1280
	help
	  The H.264 stream width.  If it differs from NN_CAMERA_CAP_HRES the frame
	  is HW-downscaled by the PPA (the ISP has no scaler).  The P4 H.264
	  encoder tops out at 1920 wide.

config NN_CAMERA_VRES
	int "Encoder output height (pixels, multiple of 16)"
	default 720

config NN_CAMERA_CROP_X_OFFSET
	int "PPA crop x-offset when CAP_HRES > HRES (-1 = centred)"
	default -1
	help
	  Where the encoder's HRES-wide window sits inside the CAP_HRES-wide
	  capture when the 1:1 PPA crop path is active.  Set to the full margin
	  (CAP_HRES - HRES) to discard ONLY left columns — used to drop the
	  sensor/ISP line-start chroma artifact (purple left band).  -1 keeps the
	  historic centred crop.  Even values only (YUV420).

config NN_CAMERA_CAP_HRES
	int "Sensor/ISP capture width (pixels)"
	default NN_CAMERA_HRES
	help
	  Must match the sensor mode selected under esp_cam_sensor
	  (CONFIG_CAMERA_<SENSOR>_MIPI_*).  nn_camera logs the sensor's offered
	  formats at init.  When larger than NN_CAMERA_HRES the captured frame is
	  PPA-downscaled to the encoder size (preserving full field of view — a
	  scale, not a crop).  Defaults to the encoder size => no scaling.

config NN_CAMERA_CAP_VRES
	int "Sensor/ISP capture height (pixels)"
	default NN_CAMERA_VRES

config NN_CAMERA_DIAG_ISP
	bool "ISP diagnostic mode (send raw RGB frames, no H.264)"
	default n
	help
	  Diagnostic firmware: capture raw RGB888 frames at the sensor resolution
	  with the normal ISP settings and push them (+ timestamp + settings) to the
	  media service's /diag/isp WebSocket, instead of encoding H.264.  Lets the
	  host see the true ISP output geometry/colour, bypassing PPA + encoder.

config NN_CAMERA_DIAG_HOST
	string "Diag media-service host (IPv4 or hostname)"
	default ""
	depends on NN_CAMERA_DIAG_ISP
	help
	  Where the diag frames go.  No default: set it in the build's own
	  sdkconfig (e.g. an uncommitted sdkconfig.defaults.local).  Empty =
	  capture runs, nothing is pushed.

config NN_CAMERA_DIAG_PORT
	int "Diag media-service port"
	default 8899
	depends on NN_CAMERA_DIAG_ISP

config NN_CAMERA_DIAG_INTERVAL_MS
	int "Diag capture interval (ms)"
	default 15000
	depends on NN_CAMERA_DIAG_ISP

config NN_CAMERA_DIAG_NAME
	string "Diag camera device name"
	default "p4cam"
	depends on NN_CAMERA_DIAG_ISP

config NN_CAMERA_H264_FPS
	int "H.264 target frame rate"
	default 30

config NN_CAMERA_H264_GOP
	int "H.264 GOP size (keyframe interval, frames)"
	default 30

config NN_CAMERA_H264_BITRATE
	int "H.264 target bitrate (bits/sec)"
	default 2000000
	help
	  ~2 Mbit/s (0.25 MB/s) suits 720p streaming over the C6 link.

config NN_CAMERA_H264_MIN_QP
	int "H.264 minimum quantiser (lower = crisper when bitrate permits)"
	default 20

config NN_CAMERA_H264_MAX_QP
	int "H.264 maximum quantiser (higher = holds bitrate under motion)"
	default 46

config NN_CAMERA_LDO_CHAN
	int "LDO channel powering the MIPI CSI/DSI PHY"
	default 3

config NN_CAMERA_LDO_MV
	int "MIPI PHY LDO voltage (mV)"
	default 2500

config NN_CAMERA_XCLK_PIN
	int "Generate sensor XVCLK (24MHz) on this GPIO (-1 = module self-clocks)"
	default -1

config NN_CAMERA_FOCUS_MAX
	int "VCM focus range maximum (0..MAX; DW9714-class = 1023)"
	default 1023
	help
	  Upper bound for nn_camera_set_focus().  Depends on the lens/VCM motor
	  (a 10-bit DW9714 is 0..1023).

# Raising red+blue together (vs the sensor's dominant green channel) is what
# neutralises the IMX708 green cast; r=b=1620 removes it without magenta overshoot
# (validated by runtime CCM A/B sweep 2026-07-16, variant "F").
config NN_CAMERA_WB_R_MILLI
	int "Default white-balance red gain (milli, CCM diagonal)"
	default 1620

config NN_CAMERA_WB_B_MILLI
	int "Default white-balance blue gain (milli, CCM diagonal)"
	default 1620

config NN_CAMERA_RAW_DIAG
	bool "Diagnostic: capture RAW8 (bypass ISP + H.264)"
	default n

endmenu
```

## modules/libs/nn_osal/Kconfig
```kconfig
# SPDX-License-Identifier: Apache-2.0

menuconfig NN_OSAL
	bool "nn project OS Abstraction Layer"
	default y
	help
	  Library that wraps RTOS / platform services (threads, sync, time,
	  GPIO, logging, storage, sockets, libc) behind a stable
	  nn_osal_* API.  All nn libraries (node_mgr, fw_common, nn_proto)
	  go through this instead of #include-ing <zephyr/...> directly.

if NN_OSAL

choice
	prompt "nn_osal backend"
	default NN_OSAL_BACKEND_ZEPHYR
	help
	  Which platform backend to compile.

config NN_OSAL_BACKEND_ZEPHYR
	bool "Zephyr RTOS"
	help
	  Forwards every OSAL call to the corresponding k_* / zsock_* /
	  settings_* / flash_img_* API.  Default on Zephyr targets.

endchoice

config NN_OSAL_LOG_LEVEL
	int "Default log level for nn_osal-using modules"
	default 3
	range 0 4
	help
	  0 = off, 1 = err, 2 = wrn, 3 = inf, 4 = dbg.  Per-module overrides
	  still work via Zephyr's CONFIG_LOG_*_MODULE_LEVEL knobs.

endif # NN_OSAL
```

## modules/libs/nn_pal/Kconfig
```kconfig
# SPDX-License-Identifier: Apache-2.0

menuconfig NN_PAL
	bool "nn project Platform Abstraction Layer"
	default n
	help
	  Wraps protocol subsystems (BLE, DFU, OpenThread, WiFi, mDNS)
	  behind a stable nn_pal_* API so apps + libs can stop including
	  <zephyr/bluetooth/...>, <zephyr/dfu/...>, <zephyr/net/openthread.h>,
	  <zephyr/net/wifi*>, <zephyr/net/dns_sd.h> directly.  Sister to
	  NN_OSAL — see modules/libs/nn_pal/docs/P7_scope.md.

if NN_PAL

choice
	prompt "nn_pal backend"
	default NN_PAL_BACKEND_ZEPHYR
	help
	  Which platform backend to compile.

config NN_PAL_BACKEND_ZEPHYR
	bool "Zephyr (BT host + dfu + net/openthread + wifi_mgmt + dns_sd)"
	help
	  Backend wraps Zephyr's protocol stacks.  Selected by default
	  on Zephyr targets.

endchoice

# Per-PAL subsystem gates.  Each backend source compiles only when its
# matching Zephyr stack is also enabled, so an app that doesn't use BLE
# (e.g. ncp_host_esp32c6) doesn't drag in the BT host headers.

config NN_PAL_MDNS
	bool "mDNS / DNS-SD PAL surface"
	default y if NET_HOSTNAME_ENABLE
	help
	  Compiles nn_pal_mdns_*.  Backend depends on
	  <zephyr/net/hostname.h> and <zephyr/net/dns_sd.h>.

config NN_PAL_WIFI
	bool "WiFi STA PAL surface"
	default y if NET_L2_WIFI_MGMT
	help
	  Compiles nn_pal_wifi_*.  Backend depends on
	  <zephyr/net/wifi.h> + wifi_mgmt.h.

config NN_PAL_OPENTHREAD
	bool "OpenThread PAL surface"
	default y if NET_L2_OPENTHREAD
	help
	  Compiles nn_pal_ot_*.  Backend depends on
	  <zephyr/net/openthread.h> + the openthread module headers.

config NN_PAL_BLE
	bool "BLE GATT PAL surface"
	default y if BT
	select BT_GATT_DYNAMIC_DB if BT
	help
	  Compiles nn_pal_ble_*.  Backend depends on the Zephyr BT host
	  headers.  Selects BT_GATT_DYNAMIC_DB so the backend can build
	  the GATT attribute table at runtime instead of via the
	  compile-time BT_GATT_SERVICE_DEFINE macro.

config NN_PAL_DFU
	bool "DFU / image management PAL surface"
	default y if BOOTLOADER_MCUBOOT
	help
	  Compiles nn_pal_dfu_*.  Backend depends on
	  <zephyr/dfu/flash_img.h> + <zephyr/storage/flash_map.h>.

config NN_PAL_LOG_SINK
	bool "Runtime log-backend registration PAL surface"
	default y if LOG
	help
	  Compiles nn_pal_log_sink_*.  Backend implements a Zephyr
	  LOG_BACKEND_DEFINE that forwards each processed message to a
	  caller-registered callback (used by node_mgr/coap_log.c to
	  emit D2H LOG_LINE frames).

endif # NN_PAL
```

## modules/libs/nn_proto_identity/Kconfig
```kconfig
# SPDX-License-Identifier: Apache-2.0

config NN_PROTO_IDENTITY
	bool "nn_proto P-256 identity primitives"
	default y
	help
	  Storage-agnostic ECDSA P-256 keypair / SHA-256 helpers used by
	  the gateway broker (gw_identity.c) and end-device clients
	  (nn_proto_client.c) to derive an 8-byte node_id and sign /
	  verify nn_proto frames.  Pulls in the same PSA selectors as
	  nn_proto's NN_PROTO_KEYSTORE_DEPS.
```
